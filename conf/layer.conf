## conf/layer.conf
```bitbake
# We have a conf and classes directory, add to BBPATH
BBPATH .= ":${LAYERDIR}"

# We have recipes-* directories, add to BBFILES
BBFILES += "${LAYERDIR}/recipes-*/*/*.bb \
            ${LAYERDIR}/recipes-*/*/*.bbappend"

BBFILE_COLLECTIONS += "jetson-ffmpeg"
BBFILE_PATTERN_jetson-ffmpeg = "^${LAYERDIR}/"
BBFILE_PRIORITY_jetson-ffmpeg = "6"

LAYERDEPENDS_jetson-ffmpeg = "core"
LAYERSERIES_COMPAT_jetson-ffmpeg = "dunfell gatesgarth"
```
